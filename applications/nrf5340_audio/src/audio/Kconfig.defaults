## applications/nrf5340_audio/src/audio/Kconfig.defaults
```kconfig
#
# Copyright (c) 2022 Nordic Semiconductor ASA
#
# SPDX-License-Identifier: LicenseRef-Nordic-5-Clause
#

# HEADSET
if AUDIO_DEV = 1

config LC3_ENC_CHAN_MAX
	int
	default 1

config LC3_DEC_CHAN_MAX
	int
	default 1

endif # AUDIO_DEV = 1 (HEADSET)

# GATEWAY
if AUDIO_DEV = 2

config LC3_ENC_CHAN_MAX
	int
	default 2

config LC3_DEC_CHAN_MAX
	int
	default 1

endif # AUDIO_DEV = 2 (GATEWAY)
```

## applications/nrf5340_audio/src/bluetooth/bt_ctlr/Kconfig
```kconfig
#
# Copyright (c) 2023 Nordic Semiconductor ASA
#
# SPDX-License-Identifier: LicenseRef-Nordic-5-Clause
#

rsource "Kconfig.defaults"

menu "Log levels"

module = BT_CTLR_CFG
module-str = bt-ctlr-cfg
source "subsys/logging/Kconfig.template.log_config"

endmenu # Log levels
```
