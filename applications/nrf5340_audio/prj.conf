## CMakeLists.txt
```
#
# Copyright (c) 2022 Nordic Semiconductor ASA
#
# SPDX-License-Identifier: LicenseRef-Nordic-5-Clause
#

cmake_minimum_required(VERSION 3.20.0)

if (CONFIG_AUDIO_DFU EQUAL 1)
    set(mcuboot_OVERLAY_CONFIG
    ${CMAKE_CURRENT_LIST_DIR}/dfu/conf/overlay-mcuboot.conf
    )
endif()

if (CONFIG_AUDIO_DFU EQUAL 2)
    set(mcuboot_OVERLAY_CONFIG
        ${CMAKE_CURRENT_LIST_DIR}/dfu/conf/overlay-mcuboot_external_flash.conf
    )
    set(mcuboot_DTC_OVERLAY_FILE ${CMAKE_CURRENT_LIST_DIR}/dfu/conf/overlay-dfu_external_flash.overlay)
    set(DTC_OVERLAY_FILE ${CMAKE_CURRENT_LIST_DIR}/dfu/conf/overlay-dfu_external_flash.overlay)
    set(mcuboot_PM_STATIC_YML_FILE ${CMAKE_CURRENT_LIST_DIR}/dfu/conf/pm_dfu_external_flash.yml)
    set(PM_STATIC_YML_FILE ${CMAKE_CURRENT_LIST_DIR}/dfu/conf/pm_dfu_external_flash.yml)
endif()

if ((CONFIG_AUDIO_DFU EQUAL 1) OR (CONFIG_AUDIO_DFU EQUAL 2))
    set(hci_rpmsg_b0n_OVERLAY_CONFIG ${CMAKE_CURRENT_LIST_DIR}/dfu/conf/b0n.conf)
    if (CONFIG_B0N_MINIMAL)
        list(APPEND hci_rpmsg_b0n_OVERLAY_CONFIG overlay-minimal-size.conf)
    endif()
endif()

# Flag which defines whether application is compiled as gateway/dongle or headset
add_compile_definitions(HEADSET=1)
add_compile_definitions(GATEWAY=2)

find_package(Zephyr REQUIRED HINTS $ENV{ZEPHYR_BASE})

# Set the nRF5340 Audio version. x.x.99 indicates master branch/cutting edge
project(NRF5340_AUDIO VERSION 0.5.99)

string(TIMESTAMP NRF5340_AUDIO_CORE_APP_COMP_DATE "%a %b %d %H:%M:%S %Y")

# Generate fw_info_app.c
configure_file("${CMAKE_CURRENT_SOURCE_DIR}/src/utils/fw_info_app.c.in"
               "${CMAKE_BINARY_DIR}/fw_info_app.c"
               @ONLY)

# Target sources below are specific to the nRF5340 Audio DK HW
target_sources(app PRIVATE
    src/main.c
    ${CMAKE_BINARY_DIR}/fw_info_app.c
    )

# Include application events and configuration headers
zephyr_library_include_directories(
    src/audio
    src/bluetooth
    src/drivers
    src/events
    src/modules
    src/utils
    src/utils/macros
)

zephyr_library_include_directories(app PRIVATE
    ${ZEPHYR_NRF_MODULE_DIR}/boards/arm/nrf5340_audio_dk_nrf5340)

# Application sources
add_subdirectory(src/audio)
add_subdirectory(src/bluetooth)
add_subdirectory(src/drivers)
add_subdirectory(src/events)
add_subdirectory(src/modules)
add_subdirectory(src/utils)

## LC3
if (CONFIG_SW_CODEC_LC3_T2_SOFTWARE)
    if (ZEPHYR_SDK_LC3_MODULE_DIR)
        add_subdirectory(${ZEPHYR_SDK_LC3_MODULE_DIR} sdk_lc3_bin_dir)
    else()
        message(FATAL_ERROR "LC3 repository not found\n"
                "Path: ${ZEPHYR_SDK_LC3_MODULE_DIR}/CMakeLists.txt\n"
                "Run 'west config manifest.group-filter +nrf5340_audio' "
                "and then 'west update'.\n"
                "If access is denied, contact local Nordic Semiconductor "
                "support")
    endif()
endif()

## Cirrus Logic
if (CONFIG_HW_CODEC_CIRRUS_LOGIC)
    if (ZEPHYR_CIRRUS_LOGIC_MODULE_DIR)
        add_subdirectory(${ZEPHYR_CIRRUS_LOGIC_MODULE_DIR} cirrus_logic_bin_dir)
    else()
        message(FATAL_ERROR "Cirrus Logic/sdk-mcu-drivers repository not found\n"
            "Path: ${ZEPHYR_CIRRUS_LOGIC_MODULE_DIR}/CMakeLists.txt\n"
            "Run 'west config manifest.group-filter +nrf5340_audio' "
            "and then 'west update'.\n")
    endif()
endif()
```

## Kconfig
```
#
# Copyright (c) 2018 Nordic Semiconductor ASA
#
# SPDX-License-Identifier: LicenseRef-Nordic-5-Clause
#

menuconfig NRF5340_AUDIO
	 bool "nRF5340 Audio [EXPERIMENTAL]"
	 select EXPERIMENTAL

if NRF5340_AUDIO

config AUDIO_DEV
	int "Select which device type to compile for. 1=HEADSET or 2=GATEWAY"
	range 1 2
	default 1
	help
	  Setting this variable to 1 selects that the project is compiled
	  as a HEADSET device.
	  Setting to 2 will compile as a GATEWAY.

choice NRF5340_AUDIO_TRANSPORT_MODE
	prompt "Choose BIS or CIS for ISO transport"
	default TRANSPORT_CIS

config TRANSPORT_BIS
	bool "Use BIS (Broadcast Isochronous Stream)"

config TRANSPORT_CIS
	bool "Use CIS (Connected Isochronous Stream)"

endchoice

#----------------------------------------------------------------------------#
rsource "src/audio/Kconfig"
rsource "src/bluetooth/Kconfig"
rsource "src/drivers/Kconfig"
rsource "src/events/Kconfig"
rsource "src/modules/Kconfig"
rsource "src/utils/Kconfig"
rsource "Kconfig.defaults"

#----------------------------------------------------------------------------#
menu "Logging"

config LOG_MAIN_LEVEL
	int "Log level for main file"
	default 3

config PRINT_STACK_USAGE_MS
	depends on THREAD_ANALYZER && INIT_STACKS
	int "Print stack usage every x milliseconds"
	default 5000

endmenu # Log levels

#----------------------------------------------------------------------------#
endif # NRF5340_AUDIO

source "Kconfig.zephyr"
```

## Kconfig.defaults
```
#
# Copyright (c) 2022 Nordic Semiconductor ASA
#
# SPDX-License-Identifier: LicenseRef-Nordic-5-Clause
#

config REBOOT
	default y

config MAIN_THREAD_PRIORITY
	default 10

config MAIN_STACK_SIZE
	default 1400

config SYSTEM_WORKQUEUE_STACK_SIZE
	default 1200

# As long as thread names are used, config must be set to "y"
config THREAD_NAME
	default y

config NCS_INCLUDE_RPMSG_CHILD_IMAGE
	default n

# Workaround to not use fatal_error.c in NCS. Note that the system may still
# reset on error depending on the build configuraion
config RESET_ON_FATAL_ERROR
	default n

# Default Config for Debug and Release build
config HW_CODEC_CIRRUS_LOGIC
	default y

config BT
	default y

config BOARD_ENABLE_DCDC_APP
	default y

config BOARD_ENABLE_DCDC_NET
	default y

config BOARD_ENABLE_CPUNET
	default y

config NFCT_PINS_AS_GPIOS
	default y

config ZBUS
	default y

config ZBUS_RUNTIME_OBSERVERS_POOL_SIZE
	default 6

config SENSOR
	default y

config REGULATOR
	default y

config CONTIN_ARRAY
	default y

config NRFX_I2S
	default y

config PCM_MIX
	default y

config TONE
	default y

config PSCM
	default y

config DATA_FIFO
	default y

# Enable NRFX_CLOCK for ACLK control
config NRFX_CLOCK
	default y

config I2C
	default y

choice LIBC_IMPLEMENTATION
	# NOTE: Since we are not using minimal libc, error codes from
	#       minimal libc are not used
	default NEWLIB_LIBC
endchoice

# Audio codec LC3 related defines
# FPU_SHARING enables preservation of the hardware floating point registers
# across context switches to allow multiple threads to perform concurrent
# floating point operations.
config FPU
	default y

config FPU_SHARING
	default y

# Enable SDHC interface
config DISK_DRIVERS
	default y

config DISK_DRIVER_SDMMC
	default y

# Enable SPI interface
config SPI
	default y

# Enable ADC for board version readback
config ADC
	default y

# Allocate buffer on RAM for transferring chunck of data
# from Flash to SPI
config SPI_NRFX_RAM_BUFFER_SIZE
	default 8

# Config the file system
config FILE_SYSTEM
	default y

config FAT_FILESYSTEM_ELM
	default y

config FS_FATFS_LFN
	default y
choice FS_FATFS_LFN_MODE
	# Using stack for LFN work queue
	default FS_FATFS_LFN_MODE_STACK
endchoice

# exFAT enabled to support longer file names and higher transfer speed
config FS_FATFS_EXFAT
	default y

# Set the maximum file name length to 255
config FS_FATFS_MAX_LFN
	default 255

config BT_LL_ACS_NRF53
	default y

config WATCHDOG
	default y

config TASK_WDT
	default y
```

## prj.conf
```kconfig
#
# Copyright (c) 2022 Nordic Semiconductor ASA
#
# SPDX-License-Identifier: LicenseRef-Nordic-5-Clause
#

# nRF5340 Audio
CONFIG_NRF5340_AUDIO=y

# General
CONFIG_DEBUG=y
CONFIG_DEBUG_INFO=y
CONFIG_ASSERT=y
CONFIG_STACK_USAGE=y
CONFIG_THREAD_RUNTIME_STATS=y
CONFIG_STACK_SENTINEL=y
CONFIG_INIT_STACKS=y

# Uart driver
CONFIG_SERIAL=y

# Logging
CONFIG_LOG=y
CONFIG_NEWLIB_LIBC_FLOAT_PRINTF=y
CONFIG_LOG_TAG_MAX_LEN=2
CONFIG_LOG_TAG_DEFAULT="--"
CONFIG_LOG_BACKEND_UART=y

# Console related defines
CONFIG_CONSOLE=y
CONFIG_RTT_CONSOLE=y
CONFIG_UART_CONSOLE=y

# Shell related defines
CONFIG_SHELL=y
CONFIG_KERNEL_SHELL=y
CONFIG_USE_SEGGER_RTT=y
## Disable logs on RTT
CONFIG_SHELL_RTT_INIT_LOG_LEVEL_NONE=y
CONFIG_SHELL_BACKEND_RTT=y
CONFIG_SHELL_BACKEND_SERIAL=n
CONFIG_SHELL_VT100_COLORS=y
CONFIG_SHELL_STACK_SIZE=4096
CONFIG_SHELL_CMD_BUFF_SIZE=128
## Reduce shell memory usage
CONFIG_SHELL_WILDCARD=n
CONFIG_SHELL_HELP_ON_WRONG_ARGUMENT_COUNT=n
CONFIG_SHELL_STATS=n
CONFIG_SHELL_CMDS=n
CONFIG_SHELL_HISTORY=y

# Turn off default shell commands
CONFIG_I2C_SHELL=n
CONFIG_HWINFO_SHELL=n
CONFIG_CLOCK_CONTROL_NRF_SHELL=n
CONFIG_FLASH_SHELL=n
CONFIG_DEVICE_SHELL=n

# Suppress LOG_ERR messages from sd_check_card_type. Because SPI_SDHC has no card presence method,
# assume card is in slot. Thus error message is always shown if card is not inserted
CONFIG_SD_LOG_LEVEL_OFF=y

# Suppress LOG_INF messages from hci_core
CONFIG_BT_HCI_CORE_LOG_LEVEL_WRN=y

# *** Common ***
CONFIG_AUDIO_SOURCE_I2S=y
CONFIG_BT_DEVICE_NAME="NORDIC_AUDIO"
CONFIG_BT_LOG_SNIFFER_INFO=y

# CONFIG_BT_AUDIO_PACKING_INTERLEAVED=y
# DISABLE DIRECT ADV:
# CONFIG_BT_MAX_PAIRED=4


# *** CIS ***
# CONFIG_STREAM_BIDIRECTIONAL=y

# CONFIG_BT_BAP_UNICAST_16_2_1=y
# CONFIG_BT_BAP_UNICAST_24_2_1=y


# *** BIS ***
# CONFIG_TRANSPORT_BIS=y
# CONFIG_BT_AUDIO_BROADCAST_NAME="NORDIC_BROADCAST"
# CONFIG_BT_BAP_BROADCAST_16_2_1=y
# CONFIG_BT_BAP_BROADCAST_24_2_1=y

# CONFIG_BT_AUDIO_BROADCAST_ENCRYPTED=y
# CONFIG_BT_AUDIO_BROADCAST_ENCRYPTION_KEY="1234"
```

## overlay-release.conf
```kconfig
#
# Copyright (c) 2022 Nordic Semiconductor ASA
#
# SPDX-License-Identifier: LicenseRef-Nordic-5-Clause
#

# nRF5340 Audio
CONFIG_NRF5340_AUDIO=y

# General
CONFIG_DEBUG=n
CONFIG_ASSERT=n
CONFIG_STACK_USAGE=n
CONFIG_THREAD_MONITOR=n
CONFIG_SERIAL=n
CONFIG_CONSOLE=n
CONFIG_PRINTK=n
CONFIG_UART_CONSOLE=n
```

## prj_release.conf
```kconfig
#
# Copyright (c) 2022 Nordic Semiconductor ASA
#
# SPDX-License-Identifier: LicenseRef-Nordic-5-Clause
#

# nRF5340 Audio
CONFIG_NRF5340_AUDIO=y

# General
CONFIG_DEBUG=n
CONFIG_ASSERT=n
CONFIG_STACK_USAGE=n
CONFIG_THREAD_MONITOR=n
CONFIG_SERIAL=n
CONFIG_CONSOLE=n
CONFIG_PRINTK=n
CONFIG_UART_CONSOLE=n

# USB
# Default values from src/modules/Kconfig.defaults.
# Must be changed before production.
# CONFIG_USB_DEVICE_VID=0x1915
# CONFIG_USB_DEVICE_PID=0x530A
```

## src/main.c
```c
/*
 * Copyright (c) 2018 Nordic Semiconductor ASA
 *
 * SPDX-License-Identifier: LicenseRef-Nordic-5-Clause
 */

#include <zephyr/kernel.h>
#include <zephyr/device.h>
#include <zephyr/bluetooth/bluetooth.h>
#include <zephyr/zbus/zbus.h>

#include "macros_common.h"
#include "nrf5340_audio_common.h"
#include "fw_info_app.h"
#include "led.h"
#include "button_handler.h"
#include "button_assignments.h"
#include "nrfx_clock.h"
#include "sd_card.h"
#include "bt_mgmt.h"
#include "board_version.h"
#include "channel_assignment.h"
#include "streamctrl.h"
#include "sd_card_playback.h"

#include <zephyr/logging/log.h>
LOG_MODULE_REGISTER(main, CONFIG_MAIN_LOG_LEVEL);

static struct board_version board_rev;

static int hfclock_config_and_start(void)
{
	int ret;

	/* Use this to turn on 128 MHz clock for cpu_app */
	ret = nrfx_clock_divider_set(NRF_CLOCK_DOMAIN_HFCLK, NRF_CLOCK_HFCLK_DIV_1);

	ret -= NRFX_ERROR_BASE_NUM;
	if (ret) {
		return ret;
	}

	nrfx_clock_hfclk_start();
	while (!nrfx_clock_hfclk_is_running()) {
	}

	return 0;
}

static int leds_set(void)
{
	int ret;

	/* Blink LED 3 to indicate that APP core is running */
	ret = led_blink(LED_APP_3_GREEN);
	if (ret) {
		return ret;
	}

// #if (CONFIG_AUDIO_DEV == HEADSET)
// 	enum audio_channel channel;

// 	channel_assignment_get(&channel);

// 	if (channel == AUDIO_CH_L) {
// 		ret = led_on(LED_APP_RGB, LED_COLOR_BLUE);
// 	} else {
// 		ret = led_on(LED_APP_RGB, LED_COLOR_MAGENTA);
// 	}

// 	if (ret) {
// 		return ret;
// 	}
// #elif (CONFIG_AUDIO_DEV == GATEWAY)
// 	ret = led_on(LED_APP_RGB, LED_COLOR_GREEN);
// 	if (ret) {
// 		return ret;
// 	}
// #endif /* (CONFIG_AUDIO_DEV == HEADSET) */

	ret = led_on(LED_APP_RGB, LED_COLOR_GREEN);
	if (ret) {
		return ret;
	}

	return 0;
}

static int channel_assign_check(void)
{
#if (CONFIG_AUDIO_DEV == HEADSET) && CONFIG_AUDIO_HEADSET_CHANNEL_RUNTIME
	int ret;
	bool pressed;

	ret = button_pressed(BUTTON_VOLUME_DOWN, &pressed);
	if (ret) {
		return ret;
	}

	if (pressed) {
		channel_assignment_set(AUDIO_CH_L);
		return 0;
	}

	ret = button_pressed(BUTTON_VOLUME_UP, &pressed);
	if (ret) {
		return ret;
	}

	if (pressed) {
		channel_assignment_set(AUDIO_CH_R);
		return 0;
	}
#endif

	return 0;
}

int main(void)
{
	int ret;

	LOG_DBG("nRF5340 APP core started");

	ret = hfclock_config_and_start();
	ERR_CHK(ret);

	ret = led_init();
	ERR_CHK(ret);

	ret = button_handler_init();
	ERR_CHK(ret);

	channel_assignment_init();

	ret = channel_assign_check();
	ERR_CHK(ret);

	ret = fw_info_app_print();
	ERR_CHK(ret);

	ret = board_version_valid_check();
	ERR_CHK(ret);

	ret = board_version_get(&board_rev);
	ERR_CHK(ret);

	if (board_rev.mask & BOARD_VERSION_VALID_MSK_SD_CARD) {
		ret = sd_card_init();
		if (ret != -ENODEV) {
			ERR_CHK(ret);
		}
	}

	ret = bt_mgmt_init();
	ERR_CHK(ret);

	ret = leds_set();
	ERR_CHK(ret);

	ret = streamctrl_start();
	ERR_CHK(ret);

	if (IS_ENABLED(CONFIG_SD_CARD_PLAYBACK)) {
		sd_card_playback_init();
	}
}
```

## include/nrf5340_audio_common.h
```c
/*
 * Copyright (c) 2023 Nordic Semiconductor ASA
 *
 * SPDX-License-Identifier: LicenseRef-Nordic-5-Clause
 */

#ifndef _NRF5340_AUDIO_COMMON_H_
#define _NRF5340_AUDIO_COMMON_H_

#include <nrfx_timer.h>

#define AUDIO_SYNC_TIMER_I2S_FRAME_START_EVT_CAPTURE_CHANNEL 0
#define AUDIO_SYNC_TIMER_CURR_TIME_CAPTURE_CHANNEL	     1
#define ZBUS_READ_TIMEOUT_MS				     K_MSEC(100)
#define ZBUS_ADD_OBS_TIMEOUT_MS				     K_MSEC(200)

extern const nrfx_timer_t audio_sync_timer_instance;

/***** Messages for zbus ******/

enum button_action {
	BUTTON_PRESS = 1,
};

struct button_msg {
	uint32_t button_pin;
	enum button_action button_action;
};

enum le_audio_evt_type {
	LE_AUDIO_EVT_CONFIG_RECEIVED = 1,
	LE_AUDIO_EVT_PRES_DELAY_SET,
	LE_AUDIO_EVT_STREAMING,
	LE_AUDIO_EVT_NOT_STREAMING,
	LE_AUDIO_EVT_PA_SYNC_LOST,
	LE_AUDIO_EVT_NO_VALID_CFG,
};

struct le_audio_msg {
	enum le_audio_evt_type event;
	struct bt_conn *conn;
};

struct sdu_ref_msg {
	uint32_t timestamp;
	bool adjust;
};

enum bt_mgmt_evt_type {
	BT_MGMT_EXT_ADV_WITH_PA_READY = 1,
	BT_MGMT_CONNECTED,
	BT_MGMT_SECURITY_CHANGED,
	BT_MGMT_PA_SYNC_OBJECT_READY,
	BT_MGMT_DISCONNECTED,
};

struct bt_mgmt_msg {
	enum bt_mgmt_evt_type event;
	struct bt_conn *conn;
	struct bt_le_ext_adv *ext_adv;
	struct bt_le_per_adv_sync *pa_sync;
	uint32_t broadcast_id;
};

enum volume_evt_type {
	VOLUME_UP = 1,
	VOLUME_DOWN,
	VOLUME_SET,
	VOLUME_MUTE,
	VOLUME_UNMUTE,
};

struct volume_msg {
	enum volume_evt_type event;
	uint8_t volume;
};

enum content_control_evt_type {
	MEDIA_START = 1,
	MEDIA_STOP,
};

struct content_control_msg {
	enum content_control_evt_type event;
};

#endif /* _NRF5340_AUDIO_COMMON_H_ */
```
